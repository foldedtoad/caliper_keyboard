## boards/arm/nrf52840_caliper/Kconfig
```kconfig
# nRF52840 DK NRF52840 board configuration

# Copyright (c) 2016 Nordic Semiconductor ASA
# SPDX-License-Identifier: Apache-2.0

if BOARD_NRF52840_CALIPER

config GPIO_AS_PINRESET
	bool "GPIO as pin reset (reset button)"
	default y

endif
```

## boards/arm/nrf52840_caliper/Kconfig.board
```kconfig
# nRF52840 DK NRF52840 board configuration

# Copyright (c) 2016 Nordic Semiconductor ASA
# SPDX-License-Identifier: Apache-2.0

config BOARD_NRF52840_CALIPER
	bool "nRF52840 CALIPER"
	depends on SOC_NRF52840_QIAA
```
