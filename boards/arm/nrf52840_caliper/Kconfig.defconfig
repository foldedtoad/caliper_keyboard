## boards/arm/nrf52840_caliper/Kconfig.defconfig
```kconfig
# SPDX-License-Identifier: Apache-2.0

if BOARD_NRF52840_CALIPER

if USB
config USB_DEVICE_STACK
	default y
endif

endif
```

## boards/arm/nrf52840_caliper/Kconfig.nrf52840_caliper
```kconfig
# SPDX-License-Identifier: Apache-2.0

config BOARD_NRF52840_CALIPER
	select SOC_NRF52840_QIAA
```

## boards/arm/nrf52840_caliper/board.yml
```yaml
board:
  name: nrf52840_caliper
  full_name: nRF52840 CALIPER
  vendor: foldedtoad
  socs:
  - name: nrf52840
  
```

## boards/arm/xiao_caliper/Kconfig.defconfig
```kconfig
# XIAO CALIPER board configuration

# Copyright (c) 2022 Marcin Niestroj
# Copyright (c) 2026 Robin Callender
# SPDX-License-Identifier: Apache-2.0

if BOARD_XIAO_CALIPER

source "boards/common/usb/Kconfig.cdc_acm_serial.defconfig"

endif # BOARD_XIAO_CALIPER
```

## boards/arm/xiao_caliper/Kconfig.xiao_caliper
```kconfig
# XIAO CALIPER board configuration

# Copyright (c) 2022 Marcin Niestroj
# Copyright (c) 2026 Robin Callender
# SPDX-License-Identifier: Apache-2.0

config BOARD_XIAO_CALIPER
	select SOC_NRF52840_QIAA
```

## boards/arm/xiao_caliper/board.yml
```yaml
board:
  name: xiao_caliper
  full_name: XIAO CALIPER
  vendor: seeed
  socs:
  - name: nrf52840
```
